## release/src-ra-4300/linux/linux-2.6.36.x/drivers/leddrv/Kconfig
```kconfig
menu "ASUS LED DRIVER"

config	ASUS_LEDDRV
	bool "ASUS LED driver"
	---help---
	  ASUS LED driver

if ASUS_LEDDRV
config ASUS_LEDDRV_DUAL_BAND
	bool "support dual band"
	depends on ASUS_LEDDRV=y
	---help---
	  support dual band
endif # ASUS_LEDDRV

endmenu
```

## release/src-ra-4300/linux/linux-2.6.36.x/drivers/misc/met/Kconfig
```kconfig
config MET
    bool "Enable MET tool"
    default n
    ---help---
      Say Y here to get to see options for device drivers from various
      different categories. This option alone does not add any kernel code.

      If you say N, all options in this submenu will be skipped and disabled.
```

## release/src-ra-4300/linux/linux-2.6.36.x/ralink/Kconfig.misc
```kconfig
menu "ASUS Miscellaneous options"

config  SINGLE_SKU_IN_DRIVER
	bool "Single sku in driver, not file"
	default n

config 	MTD_JFFS2_LEN
	hex "MTD JFFS2 Partition Length (Unit:Bytes)"
	default 0x0

config  MODEL_RTAC1200
	bool "RT-AC1200"
	default n

config  MODEL_RPAC56
	bool "RP-AC56"
	default n

config  MODEL_RTAC1200GA1
	bool "RT-AC1200GA1"
	default n

config  MODEL_RTAC1200GU
	bool "RT-AC1200GU"
	default n

config  MODEL_RTN11PB1
	bool "RT-N11P_b1"
	default n
	
config  MODEL_RTN10PV3
        bool "RT-N10P_V3"
        default n 

config  MODEL_RTAC51UP
	bool "RT-AC51U+"
	default n

config  MODEL_RTAC53
	bool "RT-AC53"
	default n

endmenu
```
